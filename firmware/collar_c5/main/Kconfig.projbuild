## firmware/collar_c5/main/Kconfig.projbuild
```kconfig
menu "leashLink Collar C5"

config COLLAR_WIFI_SEED_ON_BOOT
    bool "Seed collar WiFi credentials to NVS on boot"
    default n

config COLLAR_WIFI_SSID
    string "Collar WiFi SSID"
    default ""

config COLLAR_WIFI_PASSWORD
    string "Collar WiFi password"
    default ""

config COLLAR_ENABLE_LEGACY_BUZZER
    bool "Enable legacy active buzzer GPIO"
    default n

config COLLAR_ENABLE_SPEAKER_GPIO_TEST
    bool "Enable provisional speaker GPIO test"
    default n
    help
        Keep disabled until PA_CTL/PDM_P/PDM_N are confirmed from the board schematic.

config COLLAR_ENABLE_LOCAL_BURST_FEEDBACK
    bool "Enable local vibration/buzzer when collar detects burst"
    default n
    help
        Keep disabled during link bring-up. The handle should own safety decisions
        and send CONTROL_CMD feedback after fusing tension and collar motion.

config COLLAR_VIBRATION_ACTIVE_LOW
    bool "Collar vibration motor driver is active-low"
    default y
    help
        Enable when the vibration module starts running while the GPIO is low.
        Disable it for MOSFET/driver boards that vibrate on GPIO high.

endmenu
```

## firmware/handle_c3/sdkconfig.defaults
```kconfig
CONFIG_IDF_TARGET="esp32c3"
CONFIG_ESP_WIFI_ESPNOW_MAX_ENCRYPT_NUM=4
CONFIG_FREERTOS_HZ=1000
CONFIG_LOG_DEFAULT_LEVEL_INFO=y
CONFIG_MQTT_PROTOCOL_311=y
```

## firmware/handle_s3/main/Kconfig.projbuild
```kconfig
menu "leashLink"

config LEASHLINK_SENSOR_BRINGUP_ONLY
    bool "Sensor bring-up board only"
    default n
    help
        Enable this when only the light sensor, I2C heart sensor, and OLED are connected.
        It skips HX711, servo, motor, buzzer, GPS, ESP-NOW safety, and cloud telemetry tasks.

config LEASHLINK_LINK_BRINGUP_ONLY
    bool "ESP-NOW/BLE link bring-up only"
    default n
    help
        Enable this to test handle_s3 <-> collar_c5 ESP-NOW/BLE without HX711, servo, GPS, MQTT, or safety tasks.

config LEASHLINK_HANDLE_MODULE_BRINGUP_ONLY
    bool "Handle connected modules bring-up only"
    default n
    help
        Enable this for the current handle_s3 wiring: servo, battery, light, GPS,
        buzzer, heart sensor, OLED, and ESP-NOW/BLE collar link. It skips HX711,
        motor, MQTT, and full safety tasks while printing realtime module data.

config LEASHLINK_WIFI_SEED_ON_BOOT
    bool "Seed WiFi credentials to NVS on boot"
    default n

config LEASHLINK_WIFI_SSID
    string "Phone hotspot SSID"
    default ""

config LEASHLINK_WIFI_PASSWORD
    string "Phone hotspot password"
    default ""

config LEASHLINK_MQTT_URI
    string "MQTT broker URI"
    default "mqtt://192.168.216.159:1883"

config LEASHLINK_HANDLE_MOTOR_ACTIVE_LOW
    bool "Handle vibration motor driver is active-low"
    default y
    help
        Enable when the handle vibration motor module runs while the GPIO is low.
        Disable it for MOSFET/driver boards that vibrate on GPIO high.

endmenu
```
